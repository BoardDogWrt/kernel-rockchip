// SPDX-License-Identifier: (GPL-2.0+ OR MIT)
/*
 * FriendlyElec NanoPC-T4 board device tree source
 *
 * Copyright (c) 2022 FriendlyElec Computer Tech. Co., Ltd.
 * (http://www.friendlyarm.com)
 *
 * Copyright (c) 2018 Collabora Ltd.
 *
 * Copyright (c) 2020 Jensen Huang <jensenhuang@friendlyarm.com>
 * Copyright (c) 2020 Marty Jones <mj8263788@gmail.com>
 * Copyright (c) 2021 Tianling Shen <cnsztl@gmail.com>
 */

/dts-v1/;
#include "rk3399-nanopi-r4s.dts"

/ {
	model = "FriendlyElec NanoPi R4SE";
	compatible = "friendlyelec,nanopi-r4s", "rockchip,rk3399";
};

&mach {
	hwrev = <0x0b>;
	model = "NanoPi R4SE";
};

&emmc_phy {
	status = "okay";
};

&sdhci {
	status = "okay";
};
